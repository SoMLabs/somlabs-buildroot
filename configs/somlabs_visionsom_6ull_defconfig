## configs/somlabs_visionsom_6ull_defconfig
```kconfig
BR2_arm=y
BR2_cortex_a7=y
BR2_CCACHE=y
BR2_OPTIMIZE_2=y
BR2_GLOBAL_PATCH_DIR="board/somlabs/visionsom-6ull/patches"
BR2_TOOLCHAIN_EXTERNAL=y
BR2_TOOLCHAIN_EXTERNAL_GDB_SERVER_COPY=y
BR2_ROOTFS_DEVICE_CREATION_DYNAMIC_EUDEV=y
BR2_TARGET_GENERIC_GETTY_PORT="ttymxc0"
BR2_SYSTEM_DHCP="eth0"
BR2_TARGET_TZ_INFO=y
BR2_ROOTFS_POST_IMAGE_SCRIPT="board/somlabs/visionsom-6ull/post-image.sh"
BR2_LINUX_KERNEL=y
BR2_LINUX_KERNEL_CUSTOM_GIT=y
BR2_LINUX_KERNEL_CUSTOM_REPO_URL="https://github.com/SoMLabs/somlabs-linux-imx.git"
BR2_LINUX_KERNEL_CUSTOM_REPO_VERSION="somlabs_imx_5.4.47_2.2.0"
BR2_LINUX_KERNEL_DEFCONFIG="visionsom_6ull"
BR2_LINUX_KERNEL_DTS_SUPPORT=y
BR2_LINUX_KERNEL_DTB_IS_SELF_BUILT=y
BR2_LINUX_KERNEL_INTREE_DTS_NAME="visioncb-6ull-std-sd.dts"
BR2_LINUX_KERNEL_INSTALL_TARGET=y
BR2_PACKAGE_BUSYBOX_SHOW_OTHERS=y
BR2_PACKAGE_LINUX_FIRMWARE=y
BR2_PACKAGE_LINUX_FIRMWARE_BRCM_BCM43XXX=y
BR2_PACKAGE_FREESCALE_IMX=y
BR2_PACKAGE_FREESCALE_IMX_PLATFORM_IMX6UL=y
BR2_PACKAGE_FIRMWARE_IMX=y
BR2_PACKAGE_ZLIB=y
BR2_PACKAGE_CAN_UTILS=y
BR2_PACKAGE_DROPBEAR=y
BR2_PACKAGE_IPERF=y
BR2_PACKAGE_IPERF3=y
BR2_PACKAGE_IPROUTE2=y
BR2_PACKAGE_MII_DIAG=y
BR2_PACKAGE_UTIL_LINUX_LIBMOUNT=y
BR2_TARGET_ROOTFS_EXT2=y
BR2_TARGET_ROOTFS_EXT2_4=y
BR2_TARGET_ROOTFS_EXT2_SIZE="128M"
BR2_TARGET_ROOTFS_EXT2_RESBLKS=0
# BR2_TARGET_ROOTFS_TAR is not set
BR2_TARGET_ROOTFS_UBI=y
BR2_TARGET_ROOTFS_UBI_PEBSIZE=0x40000
BR2_TARGET_ROOTFS_UBI_SUBSIZE=4096
BR2_TARGET_ROOTFS_UBIFS_LEBSIZE=0x3e000
BR2_TARGET_ROOTFS_UBIFS_MINIOSIZE=0x1000
BR2_TARGET_ROOTFS_UBIFS_MAXLEBCNT=2100
BR2_TARGET_UBOOT=y
BR2_TARGET_UBOOT_BOARDNAME="visionsom_6ull"
BR2_TARGET_UBOOT_CUSTOM_GIT=y
BR2_TARGET_UBOOT_CUSTOM_REPO_URL="https://github.com/SoMLabs/somlabs-uboot-imx.git"
BR2_TARGET_UBOOT_CUSTOM_REPO_VERSION="somlabs-imx_v2020.04_5.4.47_2.2.0"
# BR2_TARGET_UBOOT_FORMAT_BIN is not set
BR2_TARGET_UBOOT_FORMAT_DTB_IMX=y
BR2_PACKAGE_HOST_GENIMAGE=y
BR2_PACKAGE_HOST_UBOOT_TOOLS=y
BR2_TARGET_ROOTFS_EXT2_BLOCKS=61440
```

## configs/somlabs_visionsom_6ull_nand2G_defconfig
```kconfig
BR2_arm=y
BR2_cortex_a7=y
BR2_CCACHE=y
BR2_OPTIMIZE_2=y
BR2_GLOBAL_PATCH_DIR="board/somlabs/visionsom-6ull/patches"
BR2_TOOLCHAIN_EXTERNAL=y
BR2_TOOLCHAIN_EXTERNAL_GDB_SERVER_COPY=y
BR2_ROOTFS_DEVICE_CREATION_DYNAMIC_EUDEV=y
BR2_TARGET_GENERIC_GETTY_PORT="ttymxc0"
BR2_SYSTEM_DHCP="eth0"
BR2_TARGET_TZ_INFO=y
BR2_ROOTFS_POST_IMAGE_SCRIPT="board/somlabs/visionsom-6ull/post-image.sh"
BR2_LINUX_KERNEL=y
BR2_LINUX_KERNEL_CUSTOM_GIT=y
BR2_LINUX_KERNEL_CUSTOM_REPO_URL="https://source.codeaurora.org/external/imx/linux-imx"
BR2_LINUX_KERNEL_CUSTOM_REPO_VERSION="rel_imx_4.19.35_1.1.0"
BR2_LINUX_KERNEL_USE_CUSTOM_CONFIG=y
BR2_LINUX_KERNEL_CUSTOM_CONFIG_FILE="board/somlabs/visionsom-6ull/visionsom-6ull-linux_defconfig"
BR2_LINUX_KERNEL_DTS_SUPPORT=y
BR2_LINUX_KERNEL_CUSTOM_DTS_PATH="board/somlabs/visionsom-6ull/somlabs-visionsom-6ul.dts board/somlabs/visionsom-6ull/somlabs-visionsom-6ul-emmc.dts board/somlabs/visionsom-6ull/somlabs-visionsom-6ull.dts board/somlabs/visionsom-6ull/somlabs-visionsom-6ull-emmc.dts board/somlabs/visionsom-6ull/somlabs-visionsom-6ull-nand.dts board/somlabs/visionsom-6ull/somlabs-visionsom-6ul-nand.dts"
BR2_LINUX_KERNEL_INSTALL_TARGET=y
BR2_PACKAGE_BUSYBOX_SHOW_OTHERS=y
BR2_PACKAGE_LINUX_FIRMWARE=y
BR2_PACKAGE_LINUX_FIRMWARE_BRCM_BCM43XXX=y
BR2_PACKAGE_LINUX_FIRMWARE_IMX_SDMA=y
BR2_PACKAGE_FREESCALE_IMX=y
BR2_PACKAGE_FREESCALE_IMX_PLATFORM_IMX6UL=y
BR2_PACKAGE_FIRMWARE_IMX=y
BR2_PACKAGE_ZLIB=y
BR2_PACKAGE_CAN_UTILS=y
BR2_PACKAGE_DROPBEAR=y
BR2_PACKAGE_IPERF=y
BR2_PACKAGE_IPERF3=y
BR2_PACKAGE_IPROUTE2=y
BR2_PACKAGE_MII_DIAG=y
BR2_PACKAGE_UTIL_LINUX_LIBMOUNT=y
BR2_TARGET_ROOTFS_EXT2=y
BR2_TARGET_ROOTFS_EXT2_4=y
BR2_TARGET_ROOTFS_EXT2_SIZE="128M"
BR2_TARGET_ROOTFS_EXT2_RESBLKS=0
# BR2_TARGET_ROOTFS_TAR is not set
BR2_TARGET_ROOTFS_UBI=y
BR2_TARGET_ROOTFS_UBI_SUBSIZE=2048
BR2_TARGET_ROOTFS_UBIFS=y
BR2_TARGET_ROOTFS_UBIFS_LEBSIZE=0x1f000
BR2_TARGET_ROOTFS_UBIFS_MAXLEBCNT=2100
BR2_TARGET_UBOOT=y
BR2_TARGET_UBOOT_BOARDNAME="somlabs_visionsom_6ull"
BR2_TARGET_UBOOT_CUSTOM_GIT=y
BR2_TARGET_UBOOT_CUSTOM_REPO_URL="https://github.com/SoMLabs/somlabs-uboot-imx.git"
BR2_TARGET_UBOOT_CUSTOM_REPO_VERSION="somlabs-visionsom-6ull-rel_3.0.4"
# BR2_TARGET_UBOOT_FORMAT_BIN is not set
BR2_TARGET_UBOOT_FORMAT_DTB_IMX=y
BR2_PACKAGE_HOST_GENIMAGE=y
BR2_PACKAGE_HOST_UBOOT_TOOLS=y
BR2_TARGET_ROOTFS_EXT2_BLOCKS=61440
```

## configs/somlabs_visionsom_6ull_nand_flasher_defconfig
```kconfig
BR2_arm=y
BR2_cortex_a7=y
BR2_CCACHE=y
BR2_GLOBAL_PATCH_DIR="board/somlabs/visionsom-6ull/patches"
BR2_TOOLCHAIN_EXTERNAL=y
BR2_ROOTFS_DEVICE_CREATION_DYNAMIC_MDEV=y
BR2_TARGET_GENERIC_GETTY_PORT="ttymxc0"
BR2_ROOTFS_OVERLAY="board/somlabs/visionsom-6ull/nandflash-rootfs-overlay"
BR2_LINUX_KERNEL=y
BR2_LINUX_KERNEL_CUSTOM_GIT=y
BR2_LINUX_KERNEL_CUSTOM_REPO_URL="git://git.freescale.com/imx/linux-imx.git"
BR2_LINUX_KERNEL_CUSTOM_REPO_VERSION="rel_imx_4.9.x_1.0.0_ga"
BR2_LINUX_KERNEL_USE_CUSTOM_CONFIG=y
BR2_LINUX_KERNEL_CUSTOM_CONFIG_FILE="board/somlabs/visionsom-6ull/visionsom-6ull-linux_nand_flasher_defconfig"
BR2_LINUX_KERNEL_DTS_SUPPORT=y
BR2_LINUX_KERNEL_USE_CUSTOM_DTS=y
BR2_LINUX_KERNEL_CUSTOM_DTS_PATH="board/somlabs/visionsom-6ull/somlabs-visionsom-6ul.dts board/somlabs/visionsom-6ull/somlabs-visionsom-6ul-emmc.dts board/somlabs/visionsom-6ull/somlabs-visionsom-6ull.dts board/somlabs/visionsom-6ull/somlabs-visionsom-6ull-emmc.dts board/somlabs/visionsom-6ull/somlabs-visionsom-6ull-nand.dts board/somlabs/visionsom-6ull/somlabs-visionsom-6ul-nand.dts"
BR2_PACKAGE_MTD=y
# BR2_PACKAGE_MTD_FLASHCP is not set
# BR2_PACKAGE_MTD_FLASH_LOCK is not set
# BR2_PACKAGE_MTD_FLASH_UNLOCK is not set
# BR2_PACKAGE_MTD_MTD_DEBUG is not set
BR2_PACKAGE_MTD_MTDPART=y
# BR2_PACKAGE_MTD_NANDDUMP is not set
# BR2_PACKAGE_MTD_NANDTEST is not set
# BR2_PACKAGE_MTD_NANDWRITE is not set
BR2_PACKAGE_FREESCALE_IMX=y
BR2_PACKAGE_IMX_KOBS=y
BR2_TARGET_ROOTFS_CPIO_XZ=y
BR2_TARGET_ROOTFS_INITRAMFS=y
# BR2_TARGET_ROOTFS_TAR is not set
```

## configs/somlabs_visionsom_6ull_wlan_bt_defconfig
```kconfig
BR2_arm=y
BR2_cortex_a7=y
BR2_CCACHE=y
BR2_OPTIMIZE_2=y
BR2_GLOBAL_PATCH_DIR="board/somlabs/visionsom-6ull/patches"
BR2_TOOLCHAIN_EXTERNAL=y
BR2_TOOLCHAIN_EXTERNAL_GDB_SERVER_COPY=y
BR2_ROOTFS_DEVICE_CREATION_DYNAMIC_EUDEV=y
BR2_TARGET_GENERIC_GETTY_PORT="ttymxc0"
BR2_SYSTEM_DHCP="eth0"
BR2_TARGET_TZ_INFO=y
BR2_ROOTFS_POST_IMAGE_SCRIPT="board/somlabs/visionsom-6ull/post-image.sh"
BR2_LINUX_KERNEL=y
BR2_LINUX_KERNEL_CUSTOM_GIT=y
BR2_LINUX_KERNEL_CUSTOM_REPO_URL="git://git.freescale.com/imx/linux-imx.git"
BR2_LINUX_KERNEL_CUSTOM_REPO_VERSION="rel_imx_4.9.x_1.0.0_ga"
BR2_LINUX_KERNEL_USE_CUSTOM_CONFIG=y
BR2_LINUX_KERNEL_CUSTOM_CONFIG_FILE="board/somlabs/visionsom-6ull/visionsom-6ull-linux_defconfig"
BR2_LINUX_KERNEL_DTS_SUPPORT=y
BR2_LINUX_KERNEL_USE_CUSTOM_DTS=y
BR2_LINUX_KERNEL_CUSTOM_DTS_PATH="board/somlabs/visionsom-6ull/somlabs-visionsom-6ul.dts board/somlabs/visionsom-6ull/somlabs-visionsom-6ul-emmc.dts board/somlabs/visionsom-6ull/somlabs-visionsom-6ull.dts board/somlabs/visionsom-6ull/somlabs-visionsom-6ull-emmc.dts board/somlabs/visionsom-6ull/somlabs-visionsom-6ull-nand.dts board/somlabs/visionsom-6ull/somlabs-visionsom-6ul-nand.dts"
BR2_LINUX_KERNEL_INSTALL_TARGET=y
BR2_PACKAGE_BUSYBOX_SHOW_OTHERS=y
BR2_PACKAGE_LINUX_FIRMWARE=y
BR2_PACKAGE_FREESCALE_IMX=y
BR2_PACKAGE_FREESCALE_IMX_PLATFORM_IMX6Q=y
BR2_PACKAGE_IMX_KOBS=y
BR2_PACKAGE_FIRMWARE_IMX=y
BR2_PACKAGE_FIRMWARE_IMX_BCMDHD=y
BR2_PACKAGE_FIRMWARE_IMX_BCMDHD_1DX=y
BR2_PACKAGE_IMX_GPU_VIV=y
BR2_PACKAGE_KERNEL_MODULE_IMX_GPU_VIV=y
BR2_PACKAGE_RFKILL=y
BR2_PACKAGE_BLUEZ_TOOLS=y
BR2_PACKAGE_BLUEZ5_UTILS=y
BR2_PACKAGE_BLUEZ5_UTILS_OBEX=y
BR2_PACKAGE_BLUEZ5_UTILS_CLIENT=y
BR2_PACKAGE_BLUEZ5_UTILS_DEPRECATED=y
BR2_PACKAGE_DROPBEAR=y
BR2_PACKAGE_IPERF=y
BR2_PACKAGE_IPERF3=y
BR2_PACKAGE_MII_DIAG=y
BR2_PACKAGE_WIRELESS_TOOLS=y
BR2_PACKAGE_WPA_SUPPLICANT=y
BR2_PACKAGE_WPA_SUPPLICANT_AP_SUPPORT=y
BR2_PACKAGE_WPA_SUPPLICANT_WIFI_DISPLAY=y
BR2_PACKAGE_WPA_SUPPLICANT_AUTOSCAN=y
BR2_PACKAGE_WPA_SUPPLICANT_EAP=y
BR2_PACKAGE_WPA_SUPPLICANT_HOTSPOT=y
BR2_PACKAGE_WPA_SUPPLICANT_DEBUG_SYSLOG=y
BR2_PACKAGE_WPA_SUPPLICANT_WPS=y
BR2_PACKAGE_WPA_SUPPLICANT_CLI=y
BR2_PACKAGE_WPA_SUPPLICANT_WPA_CLIENT_SO=y
BR2_PACKAGE_WPA_SUPPLICANT_PASSPHRASE=y
BR2_PACKAGE_WPA_SUPPLICANT_DBUS_NEW=y
BR2_PACKAGE_WPA_SUPPLICANT_DBUS_INTROSPECTION=y
BR2_TARGET_ROOTFS_EXT2=y
BR2_TARGET_ROOTFS_EXT2_4=y
BR2_TARGET_ROOTFS_EXT2_SIZE="128M"
BR2_TARGET_ROOTFS_EXT2_RESBLKS=0
# BR2_TARGET_ROOTFS_TAR is not set
BR2_TARGET_ROOTFS_UBIFS=y
BR2_TARGET_ROOTFS_UBIFS_LEBSIZE=0x3e000
BR2_TARGET_ROOTFS_UBIFS_MINIOSIZE=0x1000
BR2_TARGET_ROOTFS_UBIFS_MAXLEBCNT=2100
BR2_TARGET_ROOTFS_UBI=y
BR2_TARGET_ROOTFS_UBI_PEBSIZE=0x40000
BR2_TARGET_ROOTFS_UBI_SUBSIZE=4096
BR2_TARGET_UBOOT=y
BR2_TARGET_UBOOT_BOARDNAME="somlabs_visionsom_6ull_emmc"
BR2_TARGET_UBOOT_CUSTOM_GIT=y
BR2_TARGET_UBOOT_CUSTOM_REPO_URL="https://gitlab.com/somlabs/somlabs-uboot-imx.git"
BR2_TARGET_UBOOT_CUSTOM_REPO_VERSION="somlabs-visionsom-6ull-rel_1.0.0"
BR2_TARGET_UBOOT_FORMAT_IMX=y
BR2_PACKAGE_HOST_GENIMAGE=y
BR2_PACKAGE_HOST_UBOOT_TOOLS=y
BR2_TARGET_ROOTFS_EXT2_BLOCKS=61440
```

## package/freescale-imx/firmware-imx-bcmdhd/Config.in
```kconfig
config BR2_PACKAGE_FIRMWARE_IMX_BCMDHD
	bool "firmware-imx-bcmdhd"
	depends on BR2_arm # Only relevant for i.MX
	help
      Firmware blobs and binary utils for the Murata WiFi/Bluetooth modules.

      These subdirectories provide firmware for Broadcom Bluetooth and Wifi support for i.MX Linux Releases.
      A more complete installation for Broadcom Bluetooth and Wifi enablement is available on
      nxp.com/imx6tools in the Broadcom Firmware package under Linux.
      This library is provided by Freescale as-is and doesn't have an upstream.

if BR2_PACKAGE_FIRMWARE_IMX_BCMDHD
comment "Select Murata WiFi/BT module type"

config BR2_PACKAGE_FIRMWARE_IMX_BCMDHD_1BW
	bool "1BW"

config BR2_PACKAGE_FIRMWARE_IMX_BCMDHD_1DX
	bool "1DX"

config BR2_PACKAGE_FIRMWARE_IMX_BCMDHD_SN8000
	bool "SN8000"

config BR2_PACKAGE_FIRMWARE_IMX_BCMDHD_ZP
	bool "ZP"

endif
```
